## boards/decathlon_hrm/board.yml
```yaml
board:
  name: decathlon_hrm
  full_name: Decathlon HRM Belt (Magene nRF52805)
  vendor: decathlon
  socs:
    - name: nrf52805
```

## boards/hrm_belt/board.yml
```yaml
board:
  name: hrm_belt
  full_name: HRM Belt (Magene nRF52805)
  vendor: diy
  socs:
    - name: nrf52805
```
